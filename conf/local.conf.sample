## conf/local.conf.sample
```bitbake
MACHINE ??= 'maaxboard-ddr4-2g-sdcard'
DISTRO ?= 'fsl-imx-wayland'
PACKAGE_CLASSES ?= 'package_rpm'
EXTRA_IMAGE_FEATURES ?= "debug-tweaks"
USER_CLASSES ?= "buildstats"
PATCHRESOLVE = "noop"
BB_DISKMON_DIRS ??= "\
    STOPTASKS,${TMPDIR},1G,100K \
    STOPTASKS,${DL_DIR},1G,100K \
    STOPTASKS,${SSTATE_DIR},1G,100K \
    STOPTASKS,/tmp,100M,100K \
    HALT,${TMPDIR},100M,1K \
    HALT,${DL_DIR},100M,1K \
    HALT,${SSTATE_DIR},100M,1K \
    HALT,/tmp,10M,1K"
PACKAGECONFIG:append:pn-qemu-system-native = " sdl"
CONF_VERSION = "2"

MACHINE_FEATURES:remove:maaxboard    = " nxp8987"

DL_DIR ?= "${BSPDIR}/downloads/"
ACCEPT_FSL_EULA = "1"

# Switch to Debian packaging and include package-management in the image
PACKAGE_CLASSES = "package_deb"
EXTRA_IMAGE_FEATURES += "package-management"

LICENSE_FLAGS_ACCEPTED += "commercial "
PACKAGECONFIG_pn-gstreamer1.0-plugins-ugly += "x264"
```

## conf/machine/include/maaxboard-base.inc
```bitbake
# Embest MaaxBoard common settings

MACHINEOVERRIDES =. "mx8:mx8m:mx8mq:"
MACHINEOVERRIDES =. "maaxboardbase:maaxboard:"

require conf/machine/include/imx-base.inc
require conf/machine/include/arm/armv8a/tune-cortexa53.inc

MACHINE_FEATURES += " pci wifi bluetooth bcm43455"

MACHINE_SOCARCH_FILTER:append_mx8mq = " virtual/libopenvg virtual/libgles1 virtual/libgles2 virtual/egl virtual/mesa virtual/libgl virtual/libg2d"

KERNEL_DEVICETREE = "freescale/maaxboard-dcss-hdmi.dtb"
KERNEL_DEVICETREE += "freescale/maaxboard-dcss-mipi.dtb"
KERNEL_DEVICETREE += "freescale/maaxboard-lcdif-mipi.dtb"
KERNEL_DEVICETREE += "freescale/maaxboard-dual-display.dtb"
KERNEL_DEVICETREE += "freescale/maaxboard-usb0-device.dtb"

WKS_FILE_DEPENDS:append = " uenv"
IMAGE_BOOT_FILES += "uEnv.txt"

UBOOT_CONFIG ??= "sd"
UBOOT_CONFIG[sd] = "maaxboard_defconfig,sdcard"

# Set ATF platform name
ATF_PLATFORM = "imx8mq"

# Set u-boot DTB
UBOOT_DTB_NAME = "maaxboard.dtb"

# Set imx-mkimage boot target
IMXBOOT_TARGETS = "flash_ddr4_val"

# Used by poky/meta/recipes-bsp/u-boot/u-boot.inc
SPL_BINARY = "spl/u-boot-spl.bin"

# Set DDR FIRMWARE
DDR_FIRMWARE_NAME = "ddr4_imem_1d.bin ddr4_dmem_1d.bin ddr4_imem_2d.bin ddr4_dmem_2d.bin"

# More refer to meta-fsl-bsp-release/imx/meta-bsp/classes/image_types_fsl.bbclass
IMAGE_BOOTLOADER = "imx-boot"
IMX_BOOT_SOC_TARGET = "iMX8MQ"
IMX_BOOT_SEEK = "33"
OPTEE_BIN_EXT = "8mq"

# Boot partition size [in KiB] for kernel and other data
# More refer to meta-fsl-bsp-release/imx/meta-bsp/classes/image_types_fsl.bbclass
BOOT_SPACE = "65536"

# Refer to linux-imx/drivers/tty/serial/imx.c
SERIAL_CONSOLES = "115200;ttymxc0"

LOADADDR = ""
UBOOT_SUFFIX = "bin"
UBOOT_MAKE_TARGET = ""

# Use gstreamer 1.14 from meta-freescale
PREFERRED_VERSION_gstreamer1.0 ?= "1.14.imx"
PREFERRED_VERSION_gstreamer1.0-plugins-base ?= "1.14.imx"
PREFERRED_VERSION_gstreamer1.0-plugins-good ?= "1.14.imx"
PREFERRED_VERSION_gstreamer1.0-plugins-bad ?= "1.14.imx"
PREFERRED_VERSION_gstreamer1.0-libav ?= "1.14.0"

# /etc/hostname
hostname:pn-base-files = "maaxboard"
```

## conf/machine/include/maaxboard-mini-base.inc
```bitbake
# Embest MaaxBoard Mini common settings

MACHINEOVERRIDES =. "mx8:mx8m:mx8mm:"
MACHINEOVERRIDES =. "maaxboardbase:maaxboardmini:"

require conf/machine/include/imx-base.inc
require conf/machine/include/arm/armv8a/tune-cortexa53.inc

MACHINE_FEATURES += " pci wifi bluetooth bcm43455"

KERNEL_DEVICETREE  = "freescale/maaxboard-mini-mipi.dtb"
#KERNEL_DEVICETREE += "freescale/maaxboard-mini-lvds.dtb"
KERNEL_DEVICETREE += "freescale/maaxboard-mini-device.dtb"

WKS_FILE_DEPENDS:append = " uenv"
IMAGE_BOOT_FILES += "uEnv.txt"

UBOOT_CONFIG ??= "sd"
UBOOT_CONFIG[sd] = "maaxboard_mini_defconfig,sdcard"

# Set ATF platform name
ATF_PLATFORM = "imx8mm"

# Set u-boot DTB
UBOOT_DTB_NAME = "maaxboard-mini.dtb"

# Set imx-mkimage boot target
IMXBOOT_TARGETS = "flash_ddr4_evk"

# Used by poky/meta/recipes-bsp/u-boot/u-boot.inc
SPL_BINARY = "spl/u-boot-spl.bin"

# Set DDR FIRMWARE
DDR_FIRMWARE_NAME = "ddr4_imem_1d.bin ddr4_dmem_1d.bin ddr4_imem_2d.bin ddr4_dmem_2d.bin"

# More refer to meta-fsl-bsp-release/imx/meta-bsp/classes/image_types_fsl.bbclass
IMAGE_BOOTLOADER = "imx-boot"
IMX_BOOT_SOC_TARGET = "iMX8MM"
IMX_BOOT_SEEK = "33"

# Boot partition size [in KiB] for kernel and other data
# More refer to meta-fsl-bsp-release/imx/meta-bsp/classes/image_types_fsl.bbclass
BOOT_SPACE = "65536"

# uboot-imx/include/configs/maaxboard_mini.h
# Refer to linux-imx/drivers/tty/serial/imx.c
SERIAL_CONSOLES = "115200;ttymxc0"

UBOOT_SUFFIX = "bin"
UBOOT_MAKE_TARGET = ""

# /etc/hostname
hostname:pn-base-files = "maaxboard-mini"
```

## conf/machine/include/maaxboard-nano-base.inc
```bitbake
# Embest MaaxBoard Mini common settings

MACHINEOVERRIDES =. "mx8:mx8m:mx8mn:"
MACHINEOVERRIDES =. "maaxboardbase:maaxboardnano:"

require conf/machine/include/imx-base.inc
require conf/machine/include/arm/armv8a/tune-cortexa53.inc

MACHINE_FEATURES += " wifi bluetooth nxp8987"

KERNEL_DEVICETREE  = "freescale/maaxboard-nano-mipi.dtb"

WKS_FILE_DEPENDS:append = " uenv"
IMAGE_BOOT_FILES += "uEnv.txt"


UBOOT_CONFIG ??= "sd"
UBOOT_CONFIG[sd] = "maaxboard_nano_defconfig,sdcard"

# Set ATF platform name
ATF_PLATFORM = "imx8mn"

# Set u-boot DTB
UBOOT_DTB_NAME = "maaxboard-nano.dtb"

# Set imx-mkimage boot target
IMXBOOT_TARGETS = "flash_ddr4_evk"

# Used by poky/meta/recipes-bsp/u-boot/u-boot.inc
SPL_BINARY = "spl/u-boot-spl.bin"

# Set DDR FIRMWARE
DDR_FIRMWARE_NAME = "ddr4_imem_1d_201810.bin ddr4_dmem_1d_201810.bin ddr4_imem_2d_201810.bin ddr4_dmem_2d_201810.bin"

# More refer to meta-fsl-bsp-release/imx/meta-bsp/classes/image_types_fsl.bbclass
IMAGE_BOOTLOADER = "imx-boot"
IMX_BOOT_SOC_TARGET = "iMX8MN"
IMX_BOOT_SEEK = "32"

# Boot partition size [in KiB] for kernel and other data
# More refer to meta-fsl-bsp-release/imx/meta-bsp/classes/image_types_fsl.bbclass
BOOT_SPACE = "65536"

# uboot-imx/include/configs/maaxboard_mini.h
# Refer to linux-imx/drivers/tty/serial/imx.c
SERIAL_CONSOLES = "115200;ttymxc1"

LOADADDR = ""
UBOOT_SUFFIX = "bin"
UBOOT_MAKE_TARGET = ""

# /etc/hostname
hostname:pn-base-files = "maaxboard-nano"
```

## conf/machine/maaxboard-desktop.conf
```bitbake
MACHINE="maaxboard-ddr4-2g-sdcard"
require conf/machine/maaxboard-ddr4-2g-sdcard.conf

require conf/machine/include/ubuntubasics.inc
```

## conf/machine/maaxboard-mini-desktop.conf
```bitbake
MACHINE="maaxboard-mini-ddr4-2g-sdcard"
require conf/machine/maaxboard-mini-ddr4-2g-sdcard.conf

require conf/machine/include/ubuntubasics.inc
```

## conf/machine/maaxboard-nano-desktop.conf
```bitbake
MACHINE="maaxboard-nano-ddr4-1g-sdcard"
require conf/machine/maaxboard-nano-ddr4-1g-sdcard.conf

require conf/machine/include/ubuntubasics.inc
```
